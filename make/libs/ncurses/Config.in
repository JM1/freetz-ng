## make/libs/ncurses/Config.in
```kconfig
config FREETZ_LIB_libncurses
	bool "ncurses (libncurses.so)"
	depends on !FREETZ_LIB_libncursesw
	default n
	help
		ncurses is a programming library providing an API, allowing the
		programmer to write text user interfaces in a terminal-independent
		manner. It also optimizes screen changes, in order to reduce the
		latency experienced when using remote shells.

		Ncurses stands for "new curses", and is a replacement for the
		discontinued 4.4 BSD classic curses.

if FREETZ_LIB_libncurses

config FREETZ_LIB_libform
	bool "libform (libform.so)"
	default n
	help
		The form library is a curses extension that supports easy programming of
		on-screen forms for data entry and program control.

config FREETZ_LIB_libmenu
	bool "libmenu (libmenu.so)"
	default n
	help
		The menu library is a curses extension that supports easy programming of
		menu hierarchies with a uniform but flexible interface.

config FREETZ_LIB_libpanel
	bool "libpanel (libpanel.so)"
	default n
	help
		The ncurses library by itself provides good support for screen displays
		in which the windows are tiled (non-overlapping).
		When your interface design is such that windows may dive deeper into
		the visibility stack or pop to the top at runtime, the resulting book-
		keeping can be tedious and difficult to get right. Hence the panels
		library.

endif # FREETZ_LIB_libncurses


config FREETZ_LIB_libncursesw
	bool "ncursesw (libncursesw.so)"
	default n
	help
		ncurses is a programming library providing an API, allowing the
		programmer to write text user interfaces in a terminal-independent
		manner. It also optimizes screen changes, in order to reduce the
		latency experienced when using remote shells.

		Ncurses stands for "new curses", and is a replacement for the
		discontinued 4.4 BSD classic curses.
		
		Ncursesw has additional wide-character (unicode) support.
		Ncurses and Ncursesw libraries are source-compatible, but
		not binary-compatible. 

if FREETZ_LIB_libncursesw

config FREETZ_LIB_libformw
	bool "libformw (libformw.so)"
	default n
	help
		The form library is a curses extension that supports easy programming of
		on-screen forms for data entry and program control.

config FREETZ_LIB_libmenuw
	bool "libmenuw (libmenuw.so)"
	default n
	help
		The menu library is a curses extension that supports easy programming of
		menu hierarchies with a uniform but flexible interface.

config FREETZ_LIB_libpanelw
	bool "libpanelw (libpanelw.so)"
	default n
	help
		The ncurses library by itself provides good support for screen displays
		in which the windows are tiled (non-overlapping).
		When your interface design is such that windows may dive deeper into
		the visibility stack or pop to the top at runtime, the resulting book-
		keeping can be tedious and difficult to get right. Hence the panels
		library.

endif # FREETZ_LIB_libncursesw


config FREETZ_WRAPPER_NCURSES
	bool "Select appropiate ncurses(w)"
	select FREETZ_SHARE_terminfo
	select FREETZ_LIB_libncurses if !FREETZ_LIB_libncursesw
	default n
	help
		You can only have ncurses or ncursesw installed.
		This option should be selected by all packages which
		require ncurses. Packages which need also unicode
		support should additional select FREETZ_LIB_libncursesw.


source "make/libs/ncurses/Config.in.terminfo"
```
